## boards/Seed_Studio/xiao_ble/board.yml
```yaml
board:
  name: xiao_ble
  full_name: xiao_ble
  vendor: Seed_Studio
  socs:
    - name: nrf52840
```

## tests/trigger_engine/testcase.yaml
```yaml
tests:
  trigger01.trigger_engine:
    platform_allow:
      - qemu_cortex_m3
    tags:
      - trigger
      - unit
```
